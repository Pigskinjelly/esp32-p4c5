## projects/esp32-p4c5-audio-monitor/main/Kconfig.projbuild
```kconfig
menu "Remote Audio Monitor Config"

    config MONITOR_WIFI_SSID
        string "Wi-Fi SSID"
        default "YOUR_SSID"
        help
            Wi-Fi 网络名称（要连接的 AP）。

    config MONITOR_WIFI_PASSWORD
        string "Wi-Fi Password"
        default "YOUR_PASSWORD"
        help
            Wi-Fi 密码。

    config MONITOR_AUDIO_SAMPLE_RATE
        int "Audio sample rate (Hz)"
        default 16000
        range 8000 48000

endmenu
```

## projects/esp32-p4c5-audio-monitor/sdkconfig.defaults
```kconfig
# ESP32-P4C5 远程音频监控 demo 默认配置
CONFIG_IDF_TARGET="esp32p4"
CONFIG_ESPTOOLPY_FLASHMODE_QIO=y
CONFIG_ESPTOOLPY_FLASHSIZE_16MB=y
CONFIG_PARTITION_TABLE_CUSTOM=y
CONFIG_SPIRAM=y
CONFIG_SPIRAM_SPEED_200M=y
CONFIG_FREERTOS_HZ=1000
CONFIG_IDF_EXPERIMENTAL_FEATURES=y
CONFIG_ESP32P4_SELECTS_REV_LESS_V3=y

# ---- 音频（esp_codec_dev 内置 ES8311）----
CONFIG_CODEC_ES8311_SUPPORT=y
# ---- Web 服务 WebSocket（推流音频给浏览器）----
CONFIG_HTTPD_WS_SUPPORT=y

# ---- ESP-Hosted：协处理器 = ESP32-C5（Wi-Fi 由 C5 通过 SDIO 提供）----
CONFIG_ESP_HOSTED_CP_TARGET_ESP32C5=y
# esp_wifi_remote 的 slave target（默认是 C6，必须显式设为 C5）
CONFIG_SLAVE_IDF_TARGET_ESP32C5=y
# 不选择任何"开发板"预设（保持 ESP_HOSTED_P4_DEV_BOARD_NONE），
# SDIO 引脚显式设为 ESP32-P4C5-Core 核心板内部连接（C5<->P4）：
CONFIG_ESP_HOSTED_SDIO_PIN_CLK=18
CONFIG_ESP_HOSTED_SDIO_PIN_CMD=19
CONFIG_ESP_HOSTED_SDIO_PIN_D0=14
CONFIG_ESP_HOSTED_SDIO_PIN_D1=15
CONFIG_ESP_HOSTED_SDIO_PIN_D2=16
CONFIG_ESP_HOSTED_SDIO_PIN_D3=17
CONFIG_ESP_HOSTED_SDIO_GPIO_RESET_SLAVE=54
```

## projects/esp32-p4c5-ipcam/main/Kconfig.projbuild
```kconfig
menu "Example Configuration"

    config EXAMPLE_ENABLE_MIPI_CSI_CAM_SENSOR
        bool "Enable MIPI CSI Camera Sensor"
        default y
        depends on SOC_MIPI_CSI_SUPPORTED

    if EXAMPLE_ENABLE_MIPI_CSI_CAM_SENSOR
        config EXAMPLE_MIPI_CSI_SCCB_I2C_PORT
            int "MIPI CSI SCCB I2C Port Number"
            default 0
            range 0 1

        config EXAMPLE_MIPI_CSI_SCCB_I2C_SCL_PIN
            int "MIPI CSI SCCB I2C SCL Pin"
            default 8
            range -1 56

        config EXAMPLE_MIPI_CSI_SCCB_I2C_SDA_PIN
            int "MIPI CSI SCCB I2C SDA Pin"
            default 7
            range -1 56

        config EXAMPLE_MIPI_CSI_SCCB_I2C_FREQ
            int "MIPI CSI SCCB I2C Frequency"
            default 100000
            range 100000 400000
            help
                Increasing this value can reduce the initialization time of the camera sensor.
                Please refer to the relevant instructions of the camera sensor to adjust the value.

        config EXAMPLE_MIPI_CSI_CAM_SENSOR_RESET_PIN
            int "MIPI CSI Camera Sensor Reset Pin"
            default -1
            range -1 56

        config EXAMPLE_MIPI_CSI_CAM_SENSOR_PWDN_PIN
            int "MIPI CSI Camera Sensor Power Down Pin"
            default -1
            range -1 56
    endif

    config EXAMPLE_ENABLE_PRINT_FPS_RATE_VALUE
        bool "enable print fps rate value"
        default y

    config EXAMPLE_USE_MEMORY_MAPPING
        bool "Use Memory Mapping for Buffer Allocation"
        default n
        help
        Enable this option if you want to allocate memory using memory mapping.
        This is typically useful for performance optimization or when working
        with hardware that requires mapped memory access

    config EXAMPLE_CAM_BUF_COUNT
        int "Camera Buffer Count"
        default 2
        range 2 3

    choice
        prompt "Choose the color format of the LCD"
        default LCD_PIXEL_FORMAT_RGB565
            config LCD_PIXEL_FORMAT_RGB565
                bool "RGB565"

            config LCD_PIXEL_FORMAT_RGB888
                bool "RGB888"
    endchoice

    config EXAMPLE_ENABLE_CAM_SENSOR_PIC_VFLIP
        bool "Enable Camera Sensor Picture Vertical Flip"
        default y
        help
            Select this option, enable camera sensor picture vertical flip.

    config EXAMPLE_ENABLE_CAM_SENSOR_PIC_HFLIP
        bool "Enable Camera Sensor Picture Horizontal Flip"
        default y
        help
            Select this option, enable camera sensor picture horizontal flip.

endmenu

menu "IP Camera Network"

    config IPCAM_WIFI_SSID
        string "Wi-Fi SSID"
        default "myssid"
        help
            STA 模式要连接的 Wi-Fi 名称（2.4GHz 或 5GHz 均可，C5 支持双频）。

    config IPCAM_WIFI_PASSWORD
        string "Wi-Fi Password"
        default "mypassword"
        help
            Wi-Fi 密码；留空表示开放网络。

    config IPCAM_RTSP_SELFTEST
        bool "开机做一次 RTSP 回环自测（连自己，验证出流）"
        default n
        help
            没有第二台设备可测时用：板子连自己的 127.0.0.1:554，
            走 OPTIONS/DESCRIBE/SETUP/PLAY 并统计 3 秒内的 RTP 包数。

    config IPCAM_WIFI_MAX_RETRY
        int "Wi-Fi 连接最大重试次数"
        default 10
        range 1 100

endmenu
```
